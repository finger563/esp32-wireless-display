## components/display/Kconfig.projbuild
```kconfig
menu "Display Configuration"

    config DISPLAY_WIDTH
        int "Display Width (pixels)"
        default 240
        help
            Set to the number of pixels across the width of the display.

    config DISPLAY_HEIGHT
        int "Display Height (pixels)"
        default 320
        help
            Set to the number of pixels across the height of the display.

    config DISPLAY_USE_SPI
        bool
        default y

    choice DISPLAY_TYPE
        prompt "Display Type"
        default DISPLAY_USE_ILI9341
        help
            Select which kind of Display will be used in the example.

        config DISPLAY_USE_ILI9341
            depends on IDF_TARGET_ESP32
            bool "ILI 9341"
            help
                Select ILI 9341 based display.

    endchoice # DISPLAY_TYPE

    if DISPLAY_USE_SPI
       menu "SPI Configuration"
        config DISPLAY_SPI_BUS
            int "Display SPI Bus"
            range 0 3
            default 3
            help
                Set which SPI bus the display is on.

        config DISPLAY_SPI_CLOCK_MHZ
            int "SPI clock speed (MHz)"
            range 5 80
            default 12 if IDF_TARGET_ESP32 || IDF_TARGET_ESP32C3
            default 12 if IDF_TARGET_ESP32S2
            help
                Set the clock speed (MHz) of SPI interface.

        config DISPLAY_SPI_CIPO_PIN
            int "SPI CIPO number"
            range 0 34 if IDF_TARGET_ESP32
            range 0 46 if IDF_TARGET_ESP32S2
            range 0 19 if IDF_TARGET_ESP32C3
            default 25
            help
                Set the pin number used by SPI CIPO.

        config DISPLAY_SPI_COPI_PIN
            int "SPI COPI number"
            range 0 34 if IDF_TARGET_ESP32
            range 0 46 if IDF_TARGET_ESP32S2
            range 0 19 if IDF_TARGET_ESP32C3
            default 23
            help
                Set the pin number used by SPI COPI.

        config DISPLAY_SPI_CLK_PIN
            int "SPI CLK number"
            range 0 34 if IDF_TARGET_ESP32
            range 0 46 if IDF_TARGET_ESP32S2
            range 0 19 if IDF_TARGET_ESP32C3
            default 19
            help
                Set the pin number used by SPI CLK.

        config DISPLAY_SPI_CS_PIN
            int "SPI CS number"
            range 0 34 if IDF_TARGET_ESP32
            range 0 46 if IDF_TARGET_ESP32S2
            range 0 19 if IDF_TARGET_ESP32C3
            default 22
            help
                Set the pin number used by SPI CS.
      endmenu
    endif # CONFIG_DISPLAY_USE_SPI

    if DISPLAY_USE_ILI9341
       menu "ILI9341 Pin Configuration"
        config DISPLAY_DC_PIN
            int "DC GPIO number"
            range 0 42
            default 21
            help
                Set the pin number used by Display DC.

        config DISPLAY_RST_PIN
            int "RST GPIO number"
            range 0 42
            default 18
            help
                Set the pin number used by Display RST.

        config DISPLAY_BACKLIGHT_PIN
            int "Backlight GPIO number"
            range 0 42
            default 5
            help
                Set the pin number used by Display Backlight.
      endmenu
    endif # CONFIG_DISPLAY_USE_ILI9341

endmenu
```

## components/udp_server/Kconfig.projbuild
```kconfig
menu "UDP Server Configuration"

    choice UDP_SERVER_IP_MODE
        prompt "IP Version"
        help
            UDP Server can use either IPV4 or IPV6.

        config UDP_SERVER_IPV4
            bool "IPV4"

        config UDP_SERVER_IPV6
            bool "IPV6"
            select UDP_SERVER_CONNECT_IPV6

    endchoice

    config UDP_SERVER_PORT
        int "Port"
        range 0 65535
        default 3333
        help
            Local port the example server will listen on.

endmenu
```

## components/window/Kconfig.projbuild
```kconfig
menu "Window Configuration"

    config WINDOW_MAX_PLOT_NAME_LENGTH
        int "Max Plot Name Length"
        default 100
        help
            Set to the number of characters per named plot.
            Anything beyond this value will be clipped.
            Plot names are used to ensure each plotted series is uniquely identified.
            Two plots which resolve to the same name will write to the same data and be shown as the same data.

    config WINDOW_PLOT_MAX_DATA_LENGTH
        int "Maximum number of data points per plot"
        default 500
        help
            Set to the number of data points you want to have per plotted graph.
            Larger numbers provide more complete plots at the cost of memory.

    config WINDOW_PLOT_X_SPACING
        int "Horizontal spacing (pixels) between successive points"
        default 320
        help
            Set to the number of pixels between any two successive points in the plotted graph.
            The larger this number the further (pixel) distance between each plotted point,
            and therefore the plot will transition faster / show fewer data points on the screen.

    config WINDOW_MAX_PLOTS
        int "Maximum number of plots that can be shown simultaneously."
        default 10
        help
            Maximum number of plots that can be shown at a time.
            Directly controls memory usage of the plotting infrastructure.

    config WINDOW_MAX_TEXT_LOGS
        int "Maximum number of text logs that can be shown simultaneously."
        default 7
        help
            Maximum number of text logs that can be shown at a time.
            Directly controls memory usage of the logging infrastructure.

    config WINDOW_TEXT_LOG_HEIGHT
        int "Line height (pixels) of the text logs."
        default 12
        help
            Controls which font to use and how much spacing to give each line.

endmenu
```

## main/Kconfig.projbuild
```kconfig
menu "Wireless Display Example Configuration"

    choice
        prompt "Hardware Configuration"
        default ESP_32_WROVER_KIT_V4
        help
            Select the dev-kit / hardware you're using.
            If you're using custom, make sure to configure the UART pins,
            as well as the display chipset & pin configuration.
        config ESP_32_WROVER_KIT_V4
            bool "ESP_32_WROVER_KIT_V4"
            select DISPLAY_USE_ILI9341
        config ESP_32_S2_HMI_DEVKIT_1
            bool "ESP_32_S2_HMI_DEVKIT_1"
            select DISPLAY_USE_RM68120
        config CUSTOM_HARDWARE
            bool "CUSTOM_HARDWARE"
    endchoice

    config UART_PORT
        int "UART Port"
        range 0 2 if IDF_TARGET_ESP32
        range 0 1 if IDF_TARGET_ESP32S2
        range 0 1 if IDF_TARGET_ESP32C3
        default 0 if ESP_32_WROVER_KIT_V4
        default 1 if ESP_32_S2_HMI_DEVKIT_1
        help
            Set which UART to use for receiving data for display.

    choice
        prompt "UART Baudrate (bits per second)"
        default UART_BAUDRATE_115200
        help
            Set the baudrate (bits per second) for the UART port.

        config UART_BAUDRATE_2000000
            bool "2000000"
        config UART_BAUDRATE_115200
            bool "115200"
        config UART_BAUDRATE_9600
            bool "9600"
    endchoice
    config UART_BAUDRATE
        int
        default 2000000 if UART_BAUDRATE_2000000
        default 115200 if UART_BAUDRATE_115200
        default 9600 if UART_BAUDRATE_9600

    config UART_TX
        int "UART TX number"
        range -1 34 if IDF_TARGET_ESP32
        range -1 46 if IDF_TARGET_ESP32S2
        range -1 19 if IDF_TARGET_ESP32C3
        default -1
        help
            Set the pin number used by UART TX. -1 for default assignment according to the port.

    config UART_RX
        int "UART RX number"
        range -1 34 if IDF_TARGET_ESP32
        range -1 46 if IDF_TARGET_ESP32S2
        range -1 19 if IDF_TARGET_ESP32C3
        default -1
        help
            Set the pin number used by UART RX. -1 for default assignment according to the port.

    config UART_RTS
        int "UART RTS number"
        range -1 34 if IDF_TARGET_ESP32
        range -1 46 if IDF_TARGET_ESP32S2
        range -1 19 if IDF_TARGET_ESP32C3
        default -1
        help
            Set the pin number used by UART RTS. -1 for default assignment according to the port.

    config UART_CTS
        int "UART CTS number"
        range -1 34 if IDF_TARGET_ESP32
        range -1 46 if IDF_TARGET_ESP32S2
        range -1 19 if IDF_TARGET_ESP32C3
        default -1
        help
            Set the pin number used by UART CTS. -1 for default assignment according to the port.

endmenu
```
